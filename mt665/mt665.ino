/***********************************************
 * FrSky Sbus decoder, light management        *
 * and screen display                          *
 *                                             *
 * Read channels values on SBus port (rx port) *
 * Manage ligths based on 1 channel            *
 * Patterns are 1,2 or 3 times up or down      *
 * Display them on a 1inch display             *
 ***********************************************/

#include <Modelisme.h>
#include <Servo.h>
#include "U8glib.h"

//Oled 0.96 SCL=A5, SDA=A4, VCC=3.3V
U8GLIB_SSD1306_128X64 u8g(U8G_I2C_OPT_DEV_0|U8G_I2C_OPT_NO_ACK|U8G_I2C_OPT_FAST);

//Challenger Logos
#define Logo_challenger_width 128
#define Logo_challenger_height 40
static unsigned char Logo_challenger_bits[] U8G_PROGMEM = {
   0x00, 0x00, 0x00, 0x00, 0x00, 0x00, 0x00, 0x00, 0x00, 0x00, 0x00, 0x00,
   0x00, 0x00, 0x00, 0x00, 0x00, 0x00, 0x00, 0x00, 0x00, 0x00, 0x00, 0x00,
   0x00, 0x00, 0x00, 0x00, 0x00, 0x00, 0x00, 0x00, 0x00, 0x00, 0x00, 0x00,
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   0x00, 0x00, 0x00, 0x00 };
#define Logo_challenger_small_width 63
#define Logo_challenger_small_height 16
static unsigned char Logo_challenger_small_bits[] U8G_PROGMEM = {
   0x00, 0x80, 0x01, 0x00, 0x00, 0x00, 0x00, 0x00, 0x00, 0xb0, 0x01, 0x00,
   0x00, 0x00, 0x00, 0x00, 0x00, 0x8c, 0x09, 0xc0, 0x06, 0x00, 0x00, 0x00,
   0x00, 0xc3, 0x0c, 0x40, 0x01, 0x00, 0x00, 0x00, 0xc0, 0x61, 0x06, 0xa0,
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   0x00, 0x00, 0x00, 0x00, 0x00, 0x00, 0x00, 0x00 };
#define warn_width 21
#define warn_height 16
static unsigned char rwarn_bits[] U8G_PROGMEM = {
   0xc0, 0x01, 0x00, 0xc0, 0x07, 0x00, 0xc0, 0x3f, 0x00, 0xff, 0x7f, 0x00,
   0xff, 0xff, 0x01, 0xff, 0xff, 0x03, 0xff, 0xff, 0x0f, 0xff, 0xff, 0x1f,
   0xff, 0xff, 0x1f, 0xff, 0xff, 0x0f, 0xff, 0xff, 0x03, 0xff, 0xff, 0x01,
   0xff, 0x7f, 0x00, 0xc0, 0x3f, 0x00, 0xc0, 0x07, 0x00, 0xc0, 0x01, 0x00 };
static unsigned char lwarn_bits[] U8G_PROGMEM = {
   0x00, 0x70, 0x00, 0x00, 0x78, 0x00, 0x80, 0x7f, 0x00, 0xc0, 0xff, 0x1f,
   0xf0, 0xff, 0x1f, 0xf8, 0xff, 0x1f, 0xfe, 0xff, 0x1f, 0xff, 0xff, 0x1f,
   0xff, 0xff, 0x1f, 0xfe, 0xff, 0x1f, 0xf8, 0xff, 0x1f, 0xf0, 0xff, 0x1f,
   0xc0, 0xff, 0x1f, 0x80, 0x7f, 0x00, 0x00, 0x78, 0x00, 0x00, 0x70, 0x00 };
#define brake_width 30
#define brake_height 24
static unsigned char brake_bits[] U8G_PROGMEM = {
   0x00, 0x00, 0x00, 0x00, 0x00, 0xf0, 0x07, 0x00, 0x00, 0x0e, 0x38, 0x00,
   0x10, 0x01, 0x40, 0x02, 0x88, 0x00, 0x80, 0x04, 0x48, 0xc0, 0x80, 0x08,
   0x24, 0xc0, 0x00, 0x09, 0x14, 0xc0, 0x00, 0x09, 0x16, 0xc0, 0x00, 0x12,
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   0x00, 0x0e, 0x1c, 0x00, 0x00, 0xf0, 0x03, 0x00, 0x00, 0x00, 0x00, 0x00 };
#define lights_width 39
#define lights_height 20
static unsigned char lights_bits[] U8G_PROGMEM = {
   0x00, 0x00, 0x00, 0x00, 0x00, 0x3e, 0x00, 0x00, 0x00, 0x1e, 0xfe, 0x00,
   0x00, 0x80, 0x3f, 0xf8, 0x3c, 0x00, 0xdf, 0x0f, 0xe0, 0xfc, 0x80, 0x9f,
   0x03, 0x00, 0xfe, 0x80, 0x1f, 0x00, 0x00, 0xfe, 0xc1, 0x3f, 0x00, 0x00,
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   0x00, 0x00, 0x00, 0x1c };
#define gyro_width 17
#define gyro_height 16
static unsigned char gyro_bits[] U8G_PROGMEM = {
   0x00, 0x01, 0x00, 0x00, 0x01, 0x00, 0x00, 0x01, 0x00, 0x4c, 0x27, 0x00,
   0xe0, 0x2b, 0x00, 0xf0, 0x17, 0x00, 0xf8, 0x0f, 0x00, 0xf8, 0x0f, 0x00,
   0xfb, 0xaf, 0x01, 0xf8, 0x2f, 0x00, 0xf8, 0x0f, 0x00, 0xf8, 0x0f, 0x00,
   0xf8, 0x2f, 0x00, 0xf8, 0x3f, 0x00, 0xfc, 0x7f, 0x00, 0xfc, 0x7f, 0x00 };
#define highlights_width 31
#define highlights_height 20
static unsigned char highlights_bits[] U8G_PROGMEM = {
   0x88, 0xc8, 0x03, 0x00, 0xff, 0xef, 0x7f, 0x00, 0x00, 0x30, 0xe0, 0x03,
   0x00, 0x30, 0x00, 0x07, 0x00, 0x30, 0x00, 0x1c, 0xff, 0x1b, 0x00, 0x18,
   0xff, 0x1b, 0x00, 0x30, 0x00, 0x18, 0x00, 0x20, 0x00, 0x18, 0x00, 0x60,
   0x00, 0x18, 0x00, 0x60, 0xff, 0x1b, 0x00, 0x60, 0x54, 0x19, 0x00, 0x60,
   0x00, 0x18, 0x00, 0x30, 0x00, 0x18, 0x00, 0x30, 0xff, 0x13, 0x00, 0x18,
   0xff, 0x33, 0x00, 0x0e, 0x00, 0x30, 0x80, 0x07, 0x00, 0x60, 0xf0, 0x01,
   0xff, 0xdf, 0x7f, 0x00, 0xfe, 0x9f, 0x02, 0x00 };
   
Receiver rec;
LightManager lm;

Servo myservo[8];
int angle=45;
int anglecounter=0;

//Display management
int currentTime;
int displayTime;
int nbrdisp=0;
int displayCounter=0;
int disp_occur;
int endpointx;
int endpointy;

void setup(){
  rec.setup();
  lm.setup(2, 3, 4, 5, 6, 7, 8);
  //Sbus Decoder
  myservo[0].attach(9);
  myservo[1].attach(10);
  myservo[2].attach(11);
  myservo[3].attach(12);
  myservo[4].attach(13);
  myservo[5].attach(A0);
  //Sound unit
  myservo[6].attach(A1);
  myservo[7].attach(A2);

  //Screen management
  disp_occur=0;
}

void loop(){
  delay(50);
  if (rec.read()==1){
    myservo[0].write(rec.channels[8].angle);
    myservo[1].write(rec.channels[9].angle);
    myservo[2].write(rec.channels[10].angle);
    myservo[3].write(rec.channels[12].angle);
    myservo[4].write(rec.channels[13].angle);
    myservo[5].write(rec.channels[14].angle);
    myservo[6].write(rec.channels[1].angle);
    myservo[7].write(rec.channels[15].angle);
    //myservo[8].write(rec.channels[15].angle);
  };

  //Manage ligths
  lm.checkLights(rec.channels[11].angle, rec.channels[2].angle, rec.channels[4].angle);

  //Display
  displayCounter++;
  if (displayCounter>4){
    displayCounter=0;
    draw();
  }
}

void drawingScreenChooser(){
  if (millis()<10000){
    nbrdisp=0;
  } else {
    nbrdisp=1;
  }
}

void drawScreen(int screenNumber){
    if (screenNumber==0){
      u8g.drawXBMP( 4, 12, Logo_challenger_width, Logo_challenger_height, Logo_challenger_bits);
    } else if (screenNumber==1){
      //Logo
      u8g.drawXBMP( 34, 0, Logo_challenger_small_width, Logo_challenger_small_height, Logo_challenger_small_bits);
      u8g.setFont(u8g_font_courR10);
      u8g.drawStr(35, 26, String("MT665B").c_str());
      
      //Power gauge
      u8g.drawCircle(63, 63, 32, U8G_DRAW_UPPER_RIGHT|U8G_DRAW_UPPER_LEFT);
      u8g.drawCircle(63, 63, 31, U8G_DRAW_UPPER_RIGHT|U8G_DRAW_UPPER_LEFT);
      u8g.drawCircle(63, 63, 30, U8G_DRAW_UPPER_RIGHT|U8G_DRAW_UPPER_LEFT);
      
      angle = abs(rec.channels[1].angle-90)*2;
      if (angle>175) {angle=175;};
      if (angle<30) {angle=30;};
      
      endpointx = 64 - (int) (28 * cos((angle * 71) / 4068.0));
      endpointy = 64 - (int) (28 * sin((angle * 71) / 4068.0));
      u8g.drawLine(63, 63, endpointx, endpointy);
      u8g.drawLine(64, 63, endpointx, endpointy);
      u8g.drawLine(65, 63, endpointx, endpointy);
      
      if ((lm.lWarn || lm.warnings) && lm.blinkstate) {
        u8g.drawXBMP( 1, 0, warn_width, warn_height, lwarn_bits);
      };
      if (lm.turningWarn) {
        u8g.drawXBMP( 1, 17, gyro_width, gyro_height, gyro_bits);
      };
      if (lm.brake) {
        u8g.drawXBMP( 1, 36, brake_width, brake_height, brake_bits);
      };
      if (lm.lights || lm.lightWarn) {
        u8g.drawXBMP( 127-lights_width, 17, lights_width, lights_height, lights_bits);
      };
      if (lm.highlights || lm.lightWarn) {
        u8g.drawXBMP( 127-highlights_width, 39, highlights_width, highlights_height, highlights_bits);
      };
      if ((lm.rWarn || lm.warnings) && lm.blinkstate) {
        u8g.drawXBMP( 106, 0, warn_width, warn_height, rwarn_bits);
      };
    };
}

void draw() {
  drawingScreenChooser();
  u8g.firstPage();
    do {
        drawScreen(nbrdisp);
    } while( u8g.nextPage() );
}
